## zmk-config/boards/arm/sp3000_keypad/Kconfig
```kconfig
config BOARD_SP3000_KEYPAD
    bool "SP3000 Scanner Keypad"
    depends on SOC_NRF52840_QIAA
```

## zmk-config/boards/arm/sp3000_keypad/sp3000_keypad_defconfig
```kconfig
# SPDX-License-Identifier: MIT
# SP3000 Scanner Keypad - Board Configuration

CONFIG_SOC_SERIES_NRF52X=y
CONFIG_SOC_NRF52840_QIAA=y
CONFIG_BOARD_SP3000_KEYPAD=y

# Enable MPU
CONFIG_ARM_MPU=y

# Enable GPIO
CONFIG_GPIO=y

# Enable USB
CONFIG_USB_DEVICE_STACK=y
CONFIG_USB_NRFX=y
CONFIG_ZMK_USB=y

# Enable BLE
CONFIG_BT=y
CONFIG_BT_CTLR=y
CONFIG_ZMK_BLE=y
CONFIG_ZMK_BLE_CLEAR_BONDS_ON_START=n

# Keyboard settings
CONFIG_ZMK_KEYBOARD_NAME="SP3000 Keypad"

# Enable encoder
CONFIG_EC11=y
CONFIG_EC11_TRIGGER_GLOBAL_THREAD=y

# Enable RGB underglow (SK6812)
CONFIG_ZMK_RGB_UNDERGLOW=y
CONFIG_WS2812_STRIP=y
CONFIG_ZMK_RGB_UNDERGLOW_EFF_START=0
CONFIG_ZMK_RGB_UNDERGLOW_HUE_START=0
CONFIG_ZMK_RGB_UNDERGLOW_SAT_START=100
CONFIG_ZMK_RGB_UNDERGLOW_BRT_START=50
CONFIG_ZMK_RGB_UNDERGLOW_AUTO_OFF_IDLE=y

# Battery reporting
CONFIG_ZMK_BATTERY_REPORTING=y
CONFIG_ZMK_BATTERY_REPORT_INTERVAL=60

# 32.768 KHz crystal
CONFIG_CLOCK_CONTROL_NRF_K32SRC_XTAL=y
CONFIG_CLOCK_CONTROL_NRF_K32SRC_20PPM=y

# Deep sleep for battery life
CONFIG_ZMK_SLEEP=y
CONFIG_ZMK_IDLE_SLEEP_TIMEOUT=900000

# Enable KSCAN
CONFIG_ZMK_KSCAN_MATRIX_POLLING=n

# Flash settings
CONFIG_BUILD_OUTPUT_UF2=y
CONFIG_USE_DT_CODE_PARTITION=y
CONFIG_MPU_ALLOW_FLASH_WRITE=y
CONFIG_NVS=y
CONFIG_SETTINGS_NVS=y
CONFIG_FLASH=y
CONFIG_FLASH_PAGE_LAYOUT=y
CONFIG_FLASH_MAP=y
```

## zmk-config/zephyr/Kconfig.defconfig
```kconfig
if BOARD_SP3000_KEYPAD

config BOARD
    default "sp3000_keypad"

config ZMK_USB
    default y

config ZMK_BLE
    default y

endif # BOARD_SP3000_KEYPAD
```
